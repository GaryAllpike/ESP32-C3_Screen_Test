## sdkconfig.defaults
```kconfig
# Console over USB Serial/JTAG only (same cable as flash/monitor).
# stdin/stdout for printf/getchar; avoids UART0 default pins (GPIO 20/21) conflicting with SPI MOSI/RST.
CONFIG_ESP_CONSOLE_USB_SERIAL_JTAG=y
```
